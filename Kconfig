## Kconfig
```kconfig
# ============================================================
# 仓库根目录的 Kconfig
# 路径：Kconfig
#
# 2026-11-23（终版）：删除 IINDPM 配置（输入上限改由 PSEL 硬件两档决定）
#   与诊断开关；新增 MCU 看门狗（PSEL 方案的失效安全兜底）。
# ============================================================

config OWLET_BLE_LED
	bool "Owlet 指示灯驱动（蓝牙 + 可选锁定灯）"
	default y

if OWLET_BLE_LED
config OWLET_BLE_LED_POLL_MS
	int "已连接时复查连接状态的周期（毫秒）"
	default 1000

config OWLET_BLE_LED_BLINK_ON_MS
	int "未连接时每次点亮的时长（毫秒）"
	default 100

config OWLET_BLE_LED_BLINK_OFF_MS
	int "未连接时每次熄灭的时长（毫秒）"
	default 900

config OWLET_BLE_LED_USB_COUNTS_AS_CONNECTED
	bool "USB 已连接（HID 就绪）也视为已连接并常亮"
	default n
endif

menuconfig OWLET_USB_CHARGER_SWITCH
	bool "Owlet USB 充电器自动识别与电流配置"
	default y
	help
	  通过 ZMK 的 USB HID 状态判断接口类型：ICHG 设电池充电电流，
	  psel-gpios 选择输入上限档（500mA/2.4A）。

if OWLET_USB_CHARGER_SWITCH

config OWLET_CHARGER_I2C_ADDR
	hex "BQ25601 I2C 地址"
	default 0x6B

config OWLET_CHARGER_DEFAULT_ICHG_MA
	int "硬件默认充电电流 (mA)，插入瞬间回读失败时显示用"
	default 500

config OWLET_CHARGER_SDP_ICHG_MA
	int "电脑 USB 口 (SDP) 电池充电电流 (mA)，60mA 步进"
	default 600

config OWLET_CHARGER_DCP_ICHG_MA
	int "专用充电器 (DCP) 电池充电电流 (mA)，60mA 步进"
	default 1200

config OWLET_CHARGER_POLL_INTERVAL_MS
	int "充电状态轮询间隔 (ms)"
	default 15000

endif # OWLET_USB_CHARGER_SWITCH

config OWLET_WDT
	bool "Owlet MCU 看门狗（跑飞复位后 PSEL 回安全档）"
	default y
	select WATCHDOG

if OWLET_WDT
config OWLET_WDT_TIMEOUT_MS
	int "看门狗超时 (ms)"
	default 10000

config OWLET_WDT_FEED_MS
	int "喂狗周期 (ms)"
	default 3000
endif
```

## boards/arm/owlet/Kconfig
```kconfig
# SPDX-License-Identifier: MIT

config BOARD_ENABLE_DCDC
	bool "Enable DCDC mode"
	select SOC_DCDC_NRF52X
	default y
	depends on BOARD_OWLET

# 2026-10-27 新增：VDDH 高压 DC/DC 转换器配置
config BOARD_ENABLE_DCDC_HV
	bool "Enable High Voltage DCDC converter"
	select SOC_DCDC_NRF52X_HV
	default y
	depends on BOARD_OWLET
```

## boards/arm/owlet/owlet_defconfig
```kconfig
# ============================================================
# owlet 板默认配置文件（主控 + 电源小板的基础能力）
# 路径：boards/arm/owlet/owlet_defconfig
#
# 2026-11-22（2B）：EC11/WS2812/锁定灯/HID指示灯/显示 等外设配置
#   迁入对应键盘 shield(owlet_0.conf) 与显示 shield(owlet_view.conf)，
#   板级只保留所有键盘共享的基础项，lite 版不选即不带。
# ============================================================

# SoC
CONFIG_SOC_SERIES_NRF52X=y
CONFIG_SOC_NRF52840_QIAA=y

# 基础外设
CONFIG_GPIO=y
CONFIG_SERIAL=y
CONFIG_I2C=y
CONFIG_SPI=y
CONFIG_FLASH=y
CONFIG_FLASH_MAP=y
CONFIG_FLASH_PAGE_LAYOUT=y

# 持久化
CONFIG_NVS=y
CONFIG_SETTINGS=y
CONFIG_SETTINGS_NVS=y
CONFIG_BT_SETTINGS=y
CONFIG_HWINFO=y

# USB 设备栈（仅 HID，无 CDC ACM）
CONFIG_USB_DEVICE_STACK=y

# 蓝牙
CONFIG_BT=y
CONFIG_BT_PERIPHERAL=y
CONFIG_ZMK_BLE=y
CONFIG_ZMK_USB=y

# NFC 引脚复用
CONFIG_NFCT_PINS_AS_GPIOS=y

# 外部电源控制
CONFIG_ZMK_EXT_POWER=y

# 电池燃料计
CONFIG_ZMK_MAX17048=y

# DC/DC 电源模式
CONFIG_BOARD_ENABLE_DCDC=y
CONFIG_BOARD_ENABLE_DCDC_HV=y

# 引导程序与代码分区
CONFIG_USE_DT_CODE_PARTITION=y

# 其他必需项
CONFIG_BT_CTLR=y
CONFIG_REBOOT=y
CONFIG_WATCHDOG=y

# Bootloader 魔法值
CONFIG_NRF_STORE_REBOOT_TYPE_GPREGRET=y

# 构建输出
CONFIG_BUILD_OUTPUT_UF2=y
```

## config/west.yml
```yaml
manifest:
  remotes:
    - name: zmkfirmware
      url-base: https://github.com/zmkfirmware
    - name: marcus571
      url-base: https://github.com/marcus571

  projects:
    - name: zmk
      remote: zmkfirmware
      revision: v0.3.0
      import: app/west.yml
    - name: owlet-view-pro  # 修改：拉取的新 UI 仓库名称
      remote: marcus571
      revision: main

  self:
    path: config
```

## dts/bindings/behaviors/owlet-rgb-save.yaml
```yaml
# 路径: dts/bindings/behaviors/owlet-rgb-save.yaml
description: Manual RGB save behavior
compatible: "zmk,behavior-owlet-rgb-save"
include: zero_param.yaml
```

## dts/bindings/behaviors/owlet-rgb-toggle.yaml
```yaml
description: Owlet RGB toggle behavior with power sequencing
compatible: "zmk,behavior-owlet-rgb-toggle"
include: zero_param.yaml
```

## dts/bindings/behaviors/zmk,behavior-screen-swap.yaml
```yaml
# 主仓库路径: dts/bindings/behaviors/zmk,behavior-screen-swap.yaml
description: Screen swap behavior for switching UI screens

compatible: "zmk,behavior-screen-swap"

properties: {}
```

## dts/bindings/charger/ti,bq25601.yaml
```yaml
# Owlet 自定义 binding：BQ25601 充电管理芯片（I2C）
# 驱动见 src/owlet_usb_switch.c，由 CONFIG_OWLET_USB_CHARGER_SWITCH 使能。
description: |
  TI BQ25601 单节锂电池充电管理芯片。Owlet 电源小板固定使用，I2C 地址 0x6B。
  电源小板定稿设计固定引出 INT 与 PSEL 档位开关（BSS138W），两者接到主控
  哪个 GPIO 由键盘板走线决定，因此 int-gpios 与 psel-gpios 均为必选属性，
  由键盘 shield overlay 声明；漏声明将在设备树编译期报错。

compatible: "ti,bq25601"

include: i2c-device.yaml

properties:
  int-gpios:
    type: phandle-array
    required: true
    description: |
      BQ25601 INT 引脚（开漏、低有效、256us 脉冲），必选。
      电源小板固定引出，接主控哪个 GPIO 由键盘 shield 按走线声明。
  psel-gpios:
    type: phandle-array
    required: true
    description: |
      PSEL 档位控制（经 N-MOSFET 低边开关 BSS138W），必选：
      置高 = MOSFET 导通 = PSEL 拉低 = 输入限流 2.4A（充电器档）；
      置低 = MOSFET 关断 = PSEL 被上拉 = 输入限流 500mA（电脑档/安全默认）。
      由键盘 shield overlay 按实际走线声明。
```

## src/dts/bindings/behaviors/owlet-rgb-save.yaml
```yaml
description: Manual RGB save behavior
compatible: "zmk,behavior-owlet-rgb-save"
include: zero_param.yaml
```
